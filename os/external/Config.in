## os/external/Config.in
```kconfig
source "$BR2_EXTERNAL_ORBIT_PATH/package/cc65/Config.in.host"
source "$BR2_EXTERNAL_ORBIT_PATH/package/orbit-console/Config.in"
source "$BR2_EXTERNAL_ORBIT_PATH/package/orbit-rom-nova/Config.in"
```

## os/external/configs/orbit_pynq_z2_defconfig
```kconfig
BR2_arm=y
BR2_cortex_a9=y
BR2_ARM_ENABLE_NEON=y
BR2_ARM_ENABLE_VFP=y

BR2_TOOLCHAIN_BUILDROOT_GLIBC=y
BR2_TOOLCHAIN_BUILDROOT_CXX=y
BR2_KERNEL_HEADERS_6_12=y
BR2_USE_WCHAR=y

BR2_TARGET_GENERIC_HOSTNAME="orbit"
BR2_TARGET_GENERIC_ISSUE="Orbit console"
BR2_TARGET_GENERIC_GETTY_PORT="ttyPS0"
BR2_TARGET_GENERIC_GETTY_BAUDRATE_115200=y
BR2_SYSTEM_DHCP="eth0"

BR2_ROOTFS_OVERLAY="$(BR2_EXTERNAL_ORBIT_PATH)/board/pynq-z2/rootfs-overlay"
BR2_ROOTFS_POST_BUILD_SCRIPT="$(BR2_EXTERNAL_ORBIT_PATH)/board/pynq-z2/post-build.sh"
BR2_ROOTFS_POST_IMAGE_SCRIPT="$(BR2_EXTERNAL_ORBIT_PATH)/board/pynq-z2/post-image.sh"

BR2_LINUX_KERNEL=y
BR2_LINUX_KERNEL_CUSTOM_TARBALL=y
BR2_LINUX_KERNEL_CUSTOM_TARBALL_LOCATION="$(call github,Xilinx,linux-xlnx,xlnx_rebase_v6.12_LTS_merge_6.12.60)/xlnx_rebase_v6.12_LTS_merge_6.12.60.tar.gz"
BR2_LINUX_KERNEL_DEFCONFIG="xilinx_zynq"
BR2_LINUX_KERNEL_CONFIG_FRAGMENT_FILES="$(BR2_EXTERNAL_ORBIT_PATH)/board/pynq-z2/linux.fragment"
BR2_LINUX_KERNEL_DTS_SUPPORT=y
BR2_LINUX_KERNEL_CUSTOM_DTS_DIR="$(BR2_EXTERNAL_ORBIT_PATH)/board/pynq-z2/dts"
BR2_LINUX_KERNEL_INTREE_DTS_NAME="xilinx/zynq-pynq-z2"
BR2_LINUX_KERNEL_UIMAGE=y
BR2_LINUX_KERNEL_UIMAGE_LOADADDR="0x8000"
BR2_LINUX_KERNEL_NEEDS_HOST_OPENSSL=y

BR2_TARGET_ROOTFS_EXT2=y
BR2_TARGET_ROOTFS_EXT2_4=y
BR2_TARGET_ROOTFS_EXT2_SIZE="192M"

BR2_GLOBAL_PATCH_DIR="board/xilinx/patches $(BR2_EXTERNAL_ORBIT_PATH)/board/pynq-z2/patches"

BR2_TARGET_UBOOT=y
BR2_TARGET_UBOOT_BUILD_SYSTEM_KCONFIG=y
BR2_TARGET_UBOOT_CUSTOM_TARBALL=y
BR2_TARGET_UBOOT_CUSTOM_TARBALL_LOCATION="$(call github,Xilinx,u-boot-xlnx,xlnx_rebase_v2025.01_2025.2)/xlnx_rebase_v2025.01_2025.2.tar.gz"
BR2_TARGET_UBOOT_BOARD_DEFCONFIG="xilinx_zynq_virt"
BR2_TARGET_UBOOT_CUSTOM_DTS_PATH="$(BR2_EXTERNAL_ORBIT_PATH)/board/pynq-z2/uboot/zynq-pynq-z2.dts"
BR2_TARGET_UBOOT_CUSTOM_MAKEOPTS="DEVICE_TREE=zynq-pynq-z2"
BR2_TARGET_UBOOT_CONFIG_FRAGMENT_FILES="$(BR2_EXTERNAL_ORBIT_PATH)/board/pynq-z2/uboot.fragment"
BR2_TARGET_UBOOT_NEEDS_DTC=y
BR2_TARGET_UBOOT_NEEDS_OPENSSL=y
BR2_TARGET_UBOOT_NEEDS_GNUTLS=y
BR2_TARGET_UBOOT_FORMAT_IMG=y
BR2_TARGET_UBOOT_SPL=y
BR2_TARGET_UBOOT_SPL_NAME="spl/boot.bin"

BR2_PACKAGE_BLUEZ5_UTILS=y
BR2_PACKAGE_ALSA_LIB=y
BR2_PACKAGE_ALSA_UTILS=y
BR2_PACKAGE_LIBEVDEV=y
BR2_PACKAGE_KMOD=y
BR2_PACKAGE_HOST_CC65=y
BR2_PACKAGE_ORBIT_CONSOLE=y
BR2_PACKAGE_ORBIT_ROM_NOVA=y

BR2_PACKAGE_HOST_DOSFSTOOLS=y
BR2_PACKAGE_HOST_GENIMAGE=y
BR2_PACKAGE_HOST_MTOOLS=y
BR2_PACKAGE_HOST_UBOOT_TOOLS=y
```

## os/external/package/cc65/Config.in.host
```kconfig
config BR2_PACKAGE_HOST_CC65
	bool "host cc65"
	help
	  The cc65 6502 toolchain, built for the host. Used at image build
	  time to assemble the bundled NES ROM.
```

## os/external/package/orbit-console/Config.in
```kconfig
config BR2_PACKAGE_ORBIT_CONSOLE
	bool "orbit-console"
	depends on BR2_INSTALL_LIBSTDCPP
	help
	  The Orbit console userspace: the framebuffer demo and the headless
	  NES frontend. Both talk to the PL through UIO and a reserved DDR
	  frame buffer.
```

## os/external/package/orbit-rom-nova/Config.in
```kconfig
config BR2_PACKAGE_ORBIT_ROM_NOVA
	bool "Nova the Squirrel ROM"
	depends on BR2_PACKAGE_HOST_CC65
	help
	  Build the bundled Nova the Squirrel NES ROM and install it in
	  /roms. Source: third_party/NovaTheSquirrel, GPLv3 code with
	  CC BY-NC-SA assets.
```
